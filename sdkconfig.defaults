## tests/test_bluetooth/sdkconfig.defaults
```kconfig
# Test Bluetooth - SDK config defaults
# Habilitar Bluetooth clásico para ESP32

CONFIG_BT_ENABLED=y
CONFIG_BT_CLASSIC_ENABLED=y
CONFIG_BTDM_CONTROLLER_MODE_CLASSIC_BT=y
CONFIG_BTDM_CONTROLLER_MODE_BLE=n
CONFIG_BT_ACL_CONNECTIONS=4
CONFIG_BT_ALLOCATION_FROM_SPIRAM_FIRST=n
```
